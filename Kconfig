## drivers/sensor/tdk/Kconfig
```kconfig
# Copyright (c) 2024 Analog Devices, Inc.
# SPDX-License-Identifier: Apache-2.0



rsource "icm20948/Kconfig"
```

## drivers/sensor/tdk/icm20948/Kconfig
```kconfig
# ICM-20948 9-axis motion sensor configuration
# Copyright (c) 2025
# SPDX-License-Identifier: Apache-2.0

menuconfig ICM20948
	bool "ICM-20948 9-axis motion sensor"
	default y
	depends on DT_HAS_INVENSENSE_ICM20948_ENABLED
	select I2C
	help
	  Enable driver for ICM-20948 9-axis motion sensor.
	  This sensor includes 3-axis accelerometer, 3-axis gyroscope,
	  3-axis magnetometer (AK09916), and temperature sensor.
	  Only I2C interface is supported.

if ICM20948

config ICM20948_ENABLE_TEMP
	bool "Enable temperature sensor"
	default y
	help
	  Enable temperature sensor support for ICM-20948.

config ICM20948_ENABLE_MAGN
	bool "Enable magnetometer"
	default y
	help
	  Enable magnetometer (AK09916) support for ICM-20948.

choice ICM20948_TRIGGER_MODE
	prompt "Trigger mode"
	default ICM20948_TRIGGER_NONE
	help
	  Specify the type of triggering to be used by the driver.

config ICM20948_TRIGGER_NONE
	bool "No trigger"

config ICM20948_TRIGGER_GLOBAL_THREAD
	bool "Use global thread"
	depends on GPIO
	select ICM20948_TRIGGER

config ICM20948_TRIGGER_OWN_THREAD
	bool "Use own thread"
	depends on GPIO
	select ICM20948_TRIGGER

endchoice

config ICM20948_TRIGGER
	bool

config ICM20948_THREAD_PRIORITY
	int "Thread priority"
	depends on ICM20948_TRIGGER_OWN_THREAD
	default 10
	help
	  Priority of thread used by the driver to handle interrupts.

config ICM20948_THREAD_STACK_SIZE
	int "Thread stack size"
	depends on ICM20948_TRIGGER_OWN_THREAD
	default 1024
	help
	  Stack size of thread used by the driver to handle interrupts.

config ICM20948_SENSORHUB
	bool "Enable sensor hub functionality"
	default n
	help
	  Enable sensor hub functionality to read external sensors
	  connected to the ICM-20948's auxiliary I2C bus.

config ICM20948_FIFO
	bool "Enable FIFO support"
	default n
	help
	  Enable FIFO buffer support for batch data collection.

config ICM20948_DMP
	bool "Enable Digital Motion Processor (DMP)"
	default n
	help
	  Enable DMP functionality for advanced motion processing.
	  Note: This requires additional firmware and memory.

config ICM20948_TRIGGER_WOM
	bool "Enable Wake-on-Motion trigger support"
	depends on ICM20948_TRIGGER
	help
	  Enable Wake-on-Motion trigger support for low-power applications.
  
config ICM20948_TRIGGER_FIFO
	bool "Enable FIFO trigger support"
	depends on ICM20948_TRIGGER
	help
	  Enable FIFO overflow and watermark trigger support.
  
config ICM20948_WOM_THRESHOLD_DEFAULT
	int "Default Wake-on-Motion threshold"
	depends on ICM20948_TRIGGER_WOM
	default 50
	range 0 255
	help
	  Default threshold value for Wake-on-Motion detection.

endif # ICM20948
```

## dts/bindings/sensor/invensense,icm20948.yaml
```yaml
# Copyright (c) 2024
# SPDX-License-Identifier: Apache-2.0

description: |
  Invensense ICM-20948 9-axis IMU (gyroscope, accelerometer, and magnetometer).
  Supports I2C communication interface.

compatible: "invensense,icm20948"

include: [sensor-device.yaml, i2c-device.yaml]

properties:
  int-gpios:
    type: phandle-array
    required: false
    description: |
      The INT signal. The default configuration is active-high, push-pull.
      The property value should ensure the flags properly describe the
      signal that is presented to the driver.

  fsync-gpios:
    type: phandle-array
    required: false
    description: |
      The FSYNC signal for external synchronization, often used for
      Electronic Image Stabilization (EIS).

  accel-fs:
    type: int
    default: 8
    description: |
      Default full scale of accelerometer. (Unit - g)
    enum:
      - 2
      - 4
      - 8
      - 16

  gyro-fs:
    type: int
    default: 2000
    description: |
      Default full scale of gyroscope. (Unit - dps)
    enum:
      - 250
      - 500
      - 1000
      - 2000

  magn-mode:
    type: int
    default: 4 # Continuous measurement mode 2 (20Hz)
    description: |
      Magnetometer (AK09916) operating mode.
    enum:
      - 0  # Power-down
      - 1  # Single measurement
      - 2  # Continuous measurement mode 1 (10Hz)
      - 4  # Continuous measurement mode 2 (20Hz)
      - 6  # Continuous measurement mode 3 (50Hz)
      - 8  # Continuous measurement mode 4 (100Hz)
      - 16 # Self-test mode

  byodr:
    type: int
    required: false
    description: |
      Specifies the Bypass ODR.
    enum:
      - 0 # Bypass ODR is 1.1 kHz
      - 1 # Bypass ODR is 1.125 kHz
```
